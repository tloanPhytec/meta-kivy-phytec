## conf/layer.conf
```bitbake
# We have a conf and classes directory, add to BBPATH
BBPATH .= ":${LAYERDIR}"

# We have recipes-* directories, add to BBFILES
BBFILES += "${LAYERDIR}/recipes-*/*/*.bb \
            ${LAYERDIR}/recipes-*/*/*.bbappend"

BBFILE_COLLECTIONS += "meta-kivy-phytec"
BBFILE_PATTERN_meta-kivy-phytec = "^${LAYERDIR}/"
BBFILE_PRIORITY_meta-kivy-phytec = "27"

LAYERDEPENDS_meta-kivy-phytec = "core"
LAYERSERIES_COMPAT_meta-kivy-phytec = "scarthgap"
```
